## boards/shields/shonbord/Kconfig.shield
```kconfig
config SHIELD_SHONBORD_LEFT
    def_bool $(shields_list_contains,shonbord_left)

config SHIELD_SHONBORD_RIGHT
    def_bool $(shields_list_contains,shonbord_right)

config SHIELD_SHONBORD_DONGLE
    def_bool $(shields_list_contains,shonbord_dongle)
```
